//************************************************************
//		TM52F5288	SFR  MAP
//************************************************************
	P0OE	DATA	0x91
	P4MOD	DATA	0x92
	P2OE	DATA	0x93
	OPTION	DATA	0x94
	INTFLG	DATA	0x95
	P1WKUP	DATA	0x96
	SWCMD	DATA	0x97
	PWM0PRD	DATA	0x9A
	PWM0DH	DATA	0x9B
	PWM1PRD	DATA	0x9C
	PWM1DH	DATA	0x9D
	PWMCON	DATA	0xA1
	P1MODL	DATA	0xA2
	P1MODH	DATA	0xA3
	P3MODL	DATA	0xA4
	P3MODH	DATA	0xA5
	PINMOD	DATA	0xA6
	INTE1	DATA	0xA9
	ADTKDT	DATA	0xAA
	ADCDH	DATA	0xAB
	TKDL	DATA	0xAC
	TKCON	DATA	0xAD
	CHSEL	DATA	0xAE
	LCDCON	DATA	0xB1
	LCDCON2	DATA	0xB2
	LCDPIN	DATA	0xB3
	IPH		DATA	0xB9
	IP1		DATA	0xBA
	IP1H	DATA	0xBB
	SPCON	DATA	0xBC
	SPSTA	DATA	0xBD
	SPDAT	DATA	0xBE
	P5		DATA	0xC0
	T2CON	DATA	0xC8
	RCP2L	DATA	0xCA
	RCP2H	DATA	0xCB
	TL2		DATA	0xCC
	TH2		DATA	0xCD
 	CLKCON	DATA	0xD8
 	P4		DATA	0xE8
 	CFGWL	DATA	0xF7
 	AUX1	DATA	0xF8
